## conf/layer.conf
```bitbake
BBPATH .= ":${LAYERDIR}"

BBFILES += "${LAYERDIR}/recipes-*/*/*.bb \
            ${LAYERDIR}/recipes-*/*/*.bbappend"

BBFILE_COLLECTIONS += "meta-bumperbot"
BBFILE_PATTERN_meta-bumperbot = "^${LAYERDIR}/"
BBFILE_PRIORITY_meta-bumperbot = "10"

LAYERDEPENDS_meta-bumperbot = "core"
LAYERSERIES_COMPAT_meta-bumperbot = "scarthgap"
```
